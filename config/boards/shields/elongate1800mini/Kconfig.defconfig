## config/boards/shields/elongate1800mini/Kconfig.defconfig
```kconfig
# Copyright (c) 2020 The ZMK Contributors
# SPDX-License-Identifier: MIT

if SHIELD_elongate1800mini

config ZMK_KEYBOARD_NAME
	default "elongate1800mini"

endif
```

## config/boards/shields/elongate1800mini/Kconfig.shield
```kconfig
# Copyright (c) 2020 The ZMK Contributors
# SPDX-License-Identifier: MIT

config SHIELD_elongate1800mini
	def_bool $(shields_list_contains,elongate1800mini)
```
